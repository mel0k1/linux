## drivers/net/wireless/intel/Kconfig
```kconfig
# SPDX-License-Identifier: GPL-2.0-only
config WLAN_VENDOR_INTEL
	bool "Intel devices"
	default y

if WLAN_VENDOR_INTEL

source "drivers/net/wireless/intel/iwlwifi/Kconfig"

endif # WLAN_VENDOR_INTEL
```

## drivers/net/wireless/realtek/Kconfig
```kconfig
# SPDX-License-Identifier: GPL-2.0-only
config WLAN_VENDOR_REALTEK
	bool "Realtek devices"
	default y

if WLAN_VENDOR_REALTEK

source "drivers/net/wireless/realtek/rtw88/Kconfig"

endif # WLAN_VENDOR_REALTEK
```

## sound/Kconfig
```kconfig
# SPDX-License-Identifier: GPL-2.0-only
menuconfig SOUND
        tristate "Sound card support"
        depends on HAS_IOMEM || INDIRECT_IOMEM
        help
          If you have a sound card in your computer, i.e. if it can say more
          than an occasional beep, say Y.

if SOUND

config SOUND_OSS_CORE
        bool
        default n

config SOUND_OSS_CORE_PRECLAIM
        bool "Preclaim OSS device numbers"
        depends on SOUND_OSS_CORE
        default y
        help
          With this option enabled, the kernel will claim all OSS device
          numbers if any OSS support (native or emulation) is enabled
          whether the respective module is loaded or not and try to load the
          appropriate module using sound-slot/service-* and char-major-*
          module aliases when one of the device numbers is opened.  With
          this option disabled, kernel will only claim actually in-use
          device numbers and opening a missing device will generate only the
          standard char-major-* aliases.

          The only visible difference is use of additional module aliases
          and whether OSS sound devices appear multiple times in
          /proc/devices.  sound-slot/service-* module aliases are scheduled
          to be removed (ie. PRECLAIM won't be available) and this option is
          to make the transition easier.  This option can be overridden
          during boot using the kernel parameter soundcore.preclaim_oss.

          Disabling this allows alternative OSS implementations.

          If unsure, say Y.

menuconfig SND
        tristate "Advanced Linux Sound Architecture"
        help
          Say 'Y' or 'M' to enable ALSA (Advanced Linux Sound Architecture),
          the new base sound system.

          For more information, see <http://www.alsa-project.org/>

if SND

# MiLin (M27): из upstream остались только core + HDA (common/controllers/
# codecs/core) + x86 (SND_INTEL_DSP_CONFIG). Остальные шины (pci-legacy,
# usb, soc, firewire, ...) вырезаны.

source "sound/core/Kconfig"

source "sound/hda/Kconfig"

source "sound/x86/Kconfig"

endif # SND

endif # SOUND
```
